## main/Kconfig.projbuild
```kconfig
menu "Rabbit Clock System Configuration"

    config LOCAL_TIME_ZONE
        string "Local Time Zone"
        default "JST-9"
        help
            Time zone of the region to be used

    config MONITORING_OUTPUT_GPIO_NO
        int "Monitoring Output GPIO No"
        default 17
        help
            GPIO number for monitoring signals

    config HOUR_HAND_ENABLE_OUTPUT_GPIO_NO
        int "Hour Hand enable (A) Output GPIO No"
        default 25
        help
            GPIO number

    config HOUR_HAND_STEP_OUTPUT_GPIO_NO
        int "Hour Hand step (A) Output GPIO No"
        default 26
        help
            GPIO number 

    config HOUR_HAND_DIR_OUTPUT_GPIO_NO
        int "Hour Hand dir (A) Output GPIO No"
        default 27
        help
            GPIO number

    config HOUR_HAND_RIGHT_LIMIT_INPUT_GPIO_NO
        int "Hour Hand right limit (A) input GPIO No"
        default 19
        help
            GPIO number

    config HOUR_HAND_LEFT_LIMIT_INPUT_GPIO_NO
        int "Hour Hand left limit (A) input GPIO No"
        default 18
        help
            GPIO number

    config MINUTE_HAND_ENABLE_OUTPUT_GPIO_NO
        int "Minute Hand enable (B) Output GPIO No"
        default 14
        help
            GPIO number

    config MINUTE_HAND_STEP_OUTPUT_GPIO_NO
        int "Minute Hand step (B) Output GPIO No"
        default 12
        help
            GPIO number 

    config MINUTE_HAND_DIR_OUTPUT_GPIO_NO
        int "Minute Hand dir (B) Output GPIO No"
        default 13
        help
            GPIO number

    config MINUTE_HAND_RIGHT_LIMIT_INPUT_GPIO_NO
        int "Minute Hand right limit (B) input GPIO No"
        default 2
        help
            GPIO number

    config MINUTE_HAND_LEFT_LIMIT_INPUT_GPIO_NO
        int "Minute Hand left limit (B) input GPIO No"
        default 15
        help
            GPIO number

    config STEPPER_MOTOR_STEP_DIVIDE
        int "Stepper motor step deivide"
        default 16
        help
            stepper motor stsep div (fullstep:1 half-step:2 1/16step:16)

    config IS_STEPPER_MOTOR_ROTATE_RIGHT_IS_DIR_UP
        bool "Clockwise when DIR is UP"
        default y
        help
            stepper motor driver clockwise flag


endmenu
```

## sdkconfig.defaults
```kconfig
# Irrigation System sdkconfig Default

# Cpu Freq
CONFIG_ESP32_DEFAULT_CPU_FREQ_80=n
CONFIG_ESP32_DEFAULT_CPU_FREQ_160=y
CONFIG_ESP32_DEFAULT_CPU_FREQ_240=n

# CPU1 is diable wdt
CONFIG_ESP_TASK_WDT_CHECK_IDLE_TASK_CPU0=y
CONFIG_ESP_TASK_WDT_CHECK_IDLE_TASK_CPU1=n

# Enable C++ exceptions and set emergency pool size for exception objects
CONFIG_COMPILER_CXX_EXCEPTIONS=n
#CONFIG_COMPILER_CXX_EXCEPTIONS_EMG_POOL_SIZE=1024

# Compiler Optimize
CONFIG_COMPILER_OPTIMIZATION_DEFAULT=n
CONFIG_COMPILER_OPTIMIZATION_SIZE=n
CONFIG_COMPILER_OPTIMIZATION_PERF=y
CONFIG_COMPILER_OPTIMIZATION_NONE=n

# Serial flasher config
CONFIG_ESPTOOLPY_FLASHSIZE_2MB=n
CONFIG_ESPTOOLPY_FLASHSIZE_4MB=y
CONFIG_ESPTOOLPY_FLASHSIZE="4MB"

# Partition Table
CONFIG_PARTITION_TABLE_SINGLE_APP=n
CONFIG_PARTITION_TABLE_CUSTOM=y

# Enable RTC 32kHz XTAL  (Option: Must be ESP32-WROOM-32E or higher)
#CONFIG_ESP32_RTC_CLK_SRC_INT_RC=n
#CONFIG_ESP32_RTC_CLK_SRC_EXT_CRYS=y
#CONFIG_ESP32_RTC_EXT_CRYST_ADDIT_CURRENT_NONE=y
#CONFIG_ESP32_RTC_XTAL_CAL_RETRY=1000

# Enable Bluetooth
CONFIG_BT_ENABLED=y
CONFIG_BT_BLE_50_FEATURES_SUPPORTED=n
CONFIG_BT_BLE_42_FEATURES_SUPPORTED=y
# CONFIG_BT_LE_50_FEATURE_SUPPORT is not used on ESP32, ESP32-C3 and ESP32-S3.
CONFIG_BT_LE_50_FEATURE_SUPPORT=n

# Disable Devices
CONFIG_SOC_DAC_SUPPORTED=n
CONFIG_SOC_I2S_SUPPORTED=n
CONFIG_SOC_I2C_SUPPORTED=n
CONFIG_SOC_TOUCH_SENSOR_SUPPORTED=n
CONFIG_SOC_WIFI_SUPPORTED=n
CONFIG_SOC_MCPWM_SUPPORTED=n
```
